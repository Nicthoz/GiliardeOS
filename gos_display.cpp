// Driver SSD1306 proprio (I2C) + graficos minimos.
// Usa so 1KB de RAM (o framebuffer) e ~1.5KB de flash, bem mais leve
// que Adafruit_GFX + Adafruit_SSD1306. Isso deixa memoria para os jogos.

#include <SPI.h>
#include <Wire.h>
#include <stdlib.h>
#include "gos_config.h"
#include "gos_display.h"

static uint8_t fb[SCR_W * SCR_H / 8];

static const uint8_t INIT_SEQ[] PROGMEM = {
  0xAE,             // display off
  0xD5, 0x80,       // clock
  0xA8, 0x3F,       // multiplex 64
  0xD3, 0x00,       // offset
  0x40,             // start line
  0x8D, 0x14,       // charge pump on
  0x20, 0x00,       // modo de enderecamento horizontal
  0xA1,             // segment remap
  0xC8,             // com scan invertido
  0xDA, 0x12,       // com pins
  0x81, 0xCF,       // contraste
  0xD9, 0xF1,       // pre-charge
  0xDB, 0x40,       // vcom detect
  0xA4,             // segue a RAM
  0xA6,             // normal (nao invertido)
  0xAF              // display on
};

// fonte 5x7, ASCII 32..90 (cada byte = 1 coluna, bit0 = topo)
static const uint8_t FONT[] PROGMEM = {
  0x00,0x00,0x00,0x00,0x00, 0x00,0x00,0x5F,0x00,0x00, 0x00,0x07,0x00,0x07,0x00, 0x14,0x7F,0x14,0x7F,0x14,
  0x24,0x2A,0x7F,0x2A,0x12, 0x23,0x13,0x08,0x64,0x62, 0x36,0x49,0x55,0x22,0x50, 0x00,0x05,0x03,0x00,0x00,
  0x00,0x1C,0x22,0x41,0x00, 0x00,0x41,0x22,0x1C,0x00, 0x14,0x08,0x3E,0x08,0x14, 0x08,0x08,0x3E,0x08,0x08,
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  0x63,0x14,0x08,0x14,0x63, 0x07,0x08,0x70,0x08,0x07, 0x61,0x51,0x49,0x45,0x43
};

static void oledCmds(const uint8_t* c, uint8_t n) {
  Wire.beginTransmission(OLED_ADDR);
  Wire.write((uint8_t)0x00);
  for (uint8_t i = 0; i < n; i++) Wire.write(c[i]);
  Wire.endTransmission();
}

void gfx_begin() {
  Wire.begin();
  Wire.setClock(400000);
  for (uint8_t i = 0; i < sizeof(INIT_SEQ); i++) {
    uint8_t c = pgm_read_byte(&INIT_SEQ[i]);
    oledCmds(&c, 1);
  }
  gfx_clear();
  gfx_show();
}

void gfx_clear() { memset(fb, 0, sizeof(fb)); }

void gfx_show() {
  static const uint8_t win[] = { 0x21, 0, 127, 0x22, 0, 7 };
  oledCmds(win, sizeof(win));
  for (uint16_t i = 0; i < sizeof(fb); i += 16) {
    Wire.beginTransmission(OLED_ADDR);
    Wire.write((uint8_t)0x40);
    Wire.write(fb + i, 16);
    Wire.endTransmission();
  }
}

void gfx_invert_view(uint8_t pages) {
  uint16_t n = (uint16_t)pages * SCR_W;
  for (uint16_t i = 0; i < n; i++) fb[i] ^= 0xFF;
}

void gfx_pixel(int16_t x, int16_t y, uint8_t c) {
  if ((uint16_t)x >= SCR_W || (uint16_t)y >= SCR_H) return;
  uint16_t i = x + (y >> 3) * SCR_W;
  uint8_t m = 1 << (y & 7);
  if (c == 1) fb[i] |= m;
  else if (c == 0) fb[i] &= ~m;
  else fb[i] ^= m;
}

void gfx_hline(int16_t x, int16_t y, int16_t w, uint8_t c) {
  for (int16_t i = 0; i < w; i++) gfx_pixel(x + i, y, c);
}
void gfx_vline(int16_t x, int16_t y, int16_t h, uint8_t c) {
  for (int16_t i = 0; i < h; i++) gfx_pixel(x, y + i, c);
}
void gfx_rect(int16_t x, int16_t y, int16_t w, int16_t h, uint8_t c) {
  gfx_hline(x, y, w, c); gfx_hline(x, y + h - 1, w, c);
  gfx_vline(x, y, h, c); gfx_vline(x + w - 1, y, h, c);
}
void gfx_fill(int16_t x, int16_t y, int16_t w, int16_t h, uint8_t c) {
  for (int16_t j = 0; j < h; j++) gfx_hline(x, y + j, w, c);
}
void gfx_circle_fill(int16_t cx, int16_t cy, int8_t r, uint8_t c) {
  for (int8_t y = -r; y <= r; y++)
    for (int8_t x = -r; x <= r; x++)
      if ((int16_t)x * x + (int16_t)y * y <= (int16_t)r * r + r) gfx_pixel(cx + x, cy + y, c);
}

static void drawChar(int16_t x, int16_t y, char ch, uint8_t s, uint8_t c) {
  if (ch >= 'a' && ch <= 'z') ch -= 32;
  if (ch < 32 || ch > 90) ch = '?';
  const uint8_t* g = FONT + (uint8_t)(ch - 32) * 5;
  for (uint8_t col = 0; col < 5; col++) {
    uint8_t bits = pgm_read_byte(g + col);
    for (uint8_t row = 0; row < 7; row++) {
      if (bits & (1 << row)) {
        if (s == 1) gfx_pixel(x + col, y + row, c);
        else gfx_fill(x + col * s, y + row * s, s, s, c);
      }
    }
  }
}

void gfx_text(int16_t x, int16_t y, const char* s, uint8_t scale, uint8_t c) {
  while (*s) { drawChar(x, y, *s++, scale, c); x += 6 * scale; }
}
void gfx_textP(int16_t x, int16_t y, const char* s, uint8_t scale, uint8_t c) {
  char ch;
  while ((ch = pgm_read_byte(s++))) { drawChar(x, y, ch, scale, c); x += 6 * scale; }
}
void gfx_num(int16_t x, int16_t y, int32_t n, uint8_t scale, uint8_t c) {
  char b[12];
  ltoa(n, b, 10);
  gfx_text(x, y, b, scale, c);
}
